## app/drivers/sensor/ec12/Kconfig
```kconfig
# Copyright (c) 2020 The ZMK Contributors
# SPDX-License-Identifier: MIT

menuconfig EC12
    bool "EC12 Incremental Encoder Sensor"
    depends on GPIO
    help
      Enable driver for EC12 incremental encoder sensors.
```

## app/drivers/zephyr/dts/bindings/sensor/alps,ec12.yaml
```yaml
description: |
  Sensor driver for the Alps EC12 rotary encoder

compatible: "alps,ec12"

properties:
  label:
    type: string
    required: true
  a-gpios:
    type: phandle-array
    required: true
    description: A pin for the encoder
  b-gpios:
    type: phandle-array
    required: true
    description: A pin for the encoder
  resolution:
    type: int
    description: Number of pulses per tick
    required: false
```
